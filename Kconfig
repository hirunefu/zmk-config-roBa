## Kconfig
```kconfig
# このリポジトリだけの設定項目。zephyr/module.yml の build.kconfig で読み込まれ、
# Kconfig のメニューでは「roBa (<パス>)」の下に並ぶ。
# ZMK や Zephyr の項目と名前が重ならないよう ROBA_ で始める（シールドの SHIELD_ROBA_R / SHIELD_ROBA_L とは別物）。
# 有効にするかどうかは好みの設定（config/roBa_R.conf）で決める。

config ROBA_BLE_CONN_PARAM_RETRY
    bool "Re-request the BLE connection interval when the host moves it out of the preferred range"
    depends on ZMK_BLE && BT_PERIPHERAL && BT_GAP_PERIPHERAL_PREF_PARAMS
    # 左手（ペリフェラル）には入れない。左手はホストに接続せず、右手との間隔は右手が決める
    # （ZMK は左手で BT_GAP_AUTO_UPDATE_CONN_PARAMS を切り、セントラル役に任せている。
    # cormoran/zmk の app/src/split/bluetooth/Kconfig:99-101）
    depends on !ZMK_SPLIT_BLE || ZMK_SPLIT_ROLE_CENTRAL
    help
      ホストに対してペリフェラル役の接続で、接続間隔が CONFIG_BT_PERIPHERAL_PREF_MIN_INT〜
      CONFIG_BT_PERIPHERAL_PREF_MAX_INT の外になったら、接続パラメータの更新を自分から要求し直す。
      Zephyr の BLE スタック自身は接続後の自動要求が通った後は要求し直さないので、その後にずれた間隔や、
      自動要求が断られて残った間隔を戻すためのもの。
      Zephyr の自動要求が出るまでは何もせず、要求の回数には上限があり、超えたら警告ログを出して
      諦める（ホストの決めた間隔のままつながる）。待ち時間と回数はソースの #define で決めている。
      左手との接続（右手がセントラル役）には何もしない。実装は src/ble_conn_param_retry.c。
```

## boards/shields/roBa/Kconfig.defconfig
```kconfig
if SHIELD_ROBA_R

# ホストに見える名前（BLE の機器名と USB の製品名。16 文字未満）。
# 以前は roBa_R.conf で "roBa" に上書きしていた。接続先での表示名を変えないよう "roBa" のままにする
config ZMK_KEYBOARD_NAME
    default "roBa"

config ZMK_SPLIT
    default y

config ZMK_SPLIT_ROLE_CENTRAL
    default y

endif

if SHIELD_ROBA_L

# ペリフェラルはホストに接続しないので、名前は動作に要らない（右手は名前ではなくサービスの UUID で左手を探し、
# 左手の広告に名前は入らない）。USB 接続時の製品名と、接続後に読める機器名・DIS の型番で左手を見分けられるよう、
# 従来の名前を残す
config ZMK_KEYBOARD_NAME
    default "roBa_L"

config ZMK_SPLIT
    default y

endif
```
